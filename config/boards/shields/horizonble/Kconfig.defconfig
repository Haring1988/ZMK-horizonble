## config/boards/shields/horizonble/Kconfig.defconfig
```kconfig
# Copyright (c) 2020 The ZMK Contributors
# SPDX-License-Identifier: MIT

if SHIELD_HORIZONBLE

config ZMK_KEYBOARD_NAME
    default "Horizon 52 BLE"

endif
```

## config/boards/shields/horizonble/Kconfig.shield
```kconfig
# Copyright (c) 2020 The ZMK Contributors
# SPDX-License-Identifier: MIT

config SHIELD_HORIZONBLE
    def_bool $(shields_list_contains,horizonble)
```
